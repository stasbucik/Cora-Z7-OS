## project-spec/configs/rootfsconfigs/Kconfig.user
```kconfig
menu "user packages " 
config libgpio  
	 bool "libgpio"
	 help
	
config libpwm  
	 bool "libpwm"
	 help
	
config libuio  
	 bool "libuio"
	 help
	
config gpio-demo  
	 bool "gpio-demo"
	 help
	
config gpioutil  
	 bool "gpioutil"
	 help
	
config peekpoke  
	 bool "peekpoke"
	 help
	
config pwmdemo  
	 bool "pwmdemo"
	 help
	
endmenu
```
